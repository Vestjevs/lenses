## nina_ap_fw/Kconfig.projbuild
```kconfig
menu "NINA AP UART settings"

config NINA_UART_PORT
    int "UART port number"
    range 0 2
    default 1
    help
        Select UART controller to use for STM32 communication.

config NINA_UART_TX_PIN
    int "UART TX GPIO"
    default 17
    help
        GPIO number used for UART TX.

config NINA_UART_RX_PIN
    int "UART RX GPIO"
    default 16
    help
        GPIO number used for UART RX.

config NINA_UART_BAUD
    int "UART baud rate"
    default 115200
    help
        Baud rate for UART link to STM32.

endmenu
```

## nina_ap_fw/sdkconfig.defaults
```kconfig
CONFIG_ESP_DEFAULT_CPU_FREQ_MHZ_240=y
CONFIG_ESPTOOLPY_FLASHFREQ_80M=y
CONFIG_ESP_WIFI_SOFTAP_SUPPORT=y
CONFIG_ESP_WIFI_ENABLE_WPA2_PSK=y
CONFIG_ESP_WIFI_ENABLE_WPA3_SAE=y
CONFIG_ESP_NETIF_IP_LOST_TIMER_INTERVAL=120
CONFIG_ESP_SYSTEM_PANIC_PRINT_REBOOT=y
CONFIG_MAIN_TASK_STACK_SIZE=8192
```
